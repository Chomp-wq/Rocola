## sistema/package/librespot/Config.in
```kconfig
config BR2_PACKAGE_LIBRESPOT
	bool "librespot (Spotify en la rocola)"
	depends on BR2_PACKAGE_HOST_RUSTC_TARGET_ARCH_SUPPORTS
	select BR2_PACKAGE_HOST_RUSTC
	select BR2_PACKAGE_OPENSSL
	help
	  Cliente libre de Spotify Connect (no oficial; necesita una
	  cuenta Premium). La rocola lo abre solo con el interruptor
	  «Spotify» de Ctrl+F3 encendido (apagado de fabrica) y toca
	  lo que manda por su cadena de sonido. No guarda musica.

	  https://github.com/librespot-org/librespot
```

## sistema/package/rocola-consola/Config.in
```kconfig
config BR2_PACKAGE_ROCOLA_CONSOLA
	bool "rocola-consola"
	depends on BR2_x86_64
	depends on BR2_TOOLCHAIN_USES_GLIBC
	depends on BR2_PACKAGE_MESA3D_OPENGL_ES && BR2_PACKAGE_MESA3D_OPENGL_EGL && BR2_PACKAGE_MESA3D_GBM
	select BR2_PACKAGE_ALSA_LIB
	select BR2_PACKAGE_LIBDRM
	select BR2_PACKAGE_DEJAVU
	select BR2_PACKAGE_JPEG   # las portadas con libjpeg-turbo (si falta, el lector propio)
	help
	  La rocola de Rocola OS (etapa 2): la cadena de sonido de la rocola por ALSA, y su pantalla por KMS y OpenGL ES
	  (o en modo texto).
	  Programa nativo de .NET 10 (NativeAOT); se compila en el equipo que arma el sistema (hace falta el SDK de .NET 10 ahi).
```

## sistema/package/rocola-spotify/Config.in
```kconfig
config BR2_PACKAGE_ROCOLA_SPOTIFY
	bool "rocola-spotify (Spotify dentro de la rocola)"
	depends on BR2_PACKAGE_HOST_RUSTC_TARGET_ARCH_SUPPORTS
	select BR2_PACKAGE_HOST_RUSTC
	select BR2_PACKAGE_OPENSSL
	help
	  El programa de Spotify de la rocola (sistema/rocola-spotify), hecho
	  con las piezas de librespot (no oficial; necesita Premium). La
	  rocola lo abre solo con el interruptor «Spotify» de Ctrl+F3
	  (apagado de fabrica): busca, lee la biblioteca de la cuenta y toca
	  por la cadena de sonido de la rocola. No guarda musica.
```

## sistema/package/rocola-xp/Config.in
```kconfig
config BR2_PACKAGE_ROCOLA_XP
	bool "rocola-xp"
	depends on BR2_x86_64
	depends on BR2_TOOLCHAIN_USES_GLIBC
	depends on BR2_PACKAGE_MESA3D_OPENGL_ES && BR2_PACKAGE_MESA3D_OPENGL_EGL && BR2_PACKAGE_MESA3D_GBM
	depends on BR2_PACKAGE_MPV   # el video: libmpv.so.2 (Buildroot compila mpv con -Dlibmpv=true)
	select BR2_PACKAGE_ALSA_LIB
	select BR2_PACKAGE_LIBDRM
	select BR2_PACKAGE_MPG123   # el descompresor de MP3 (libmpg123.so.0); su programa suena la cancion de prueba (rocola-prueba)
	select BR2_PACKAGE_DEJAVU   # las letras de repuesto si no estan las de XP (Nativo/Letras.cs)
	help
	  La rocola de XP traducida a Linux (sistema/rocola/Xp, «rocola-xp»): el UNICO programa de Rocola OS desde el 14-11-2026
	  (sistema/INTEGRACION_ROCOLA_XP.md); /usr/bin/rocola la abre siempre. Programa nativo de .NET 10 (NativeAOT) con SkiaSharp
	  (libSkiaSharp.so va a su lado, sin mas dependencias que glibc); se compila en el equipo que arma el sistema (hace falta el SDK
	  de .NET 10 ahi). Pone tambien la cancion de prueba (/usr/share/rocola/prueba.mp3 y el disco «Rocola OS - Prueba»), que antes
	  ponia rocola-consola (retirado).
```
